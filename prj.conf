## CMakeLists.txt
```
# SPDX-License-Identifier: Apache-2.0

cmake_minimum_required(VERSION 3.20.0)

find_package(Zephyr REQUIRED HINTS $ENV{ZEPHYR_BASE})
project(sdram_benchmark)

target_include_directories(app PRIVATE include)

# Firmware identification printed in the banner
execute_process(
  COMMAND git describe --always --dirty --abbrev=12
  WORKING_DIRECTORY ${CMAKE_CURRENT_SOURCE_DIR}
  OUTPUT_VARIABLE sb_git_rev
  OUTPUT_STRIP_TRAILING_WHITESPACE
  ERROR_QUIET
)
if(NOT sb_git_rev)
  set(sb_git_rev "unknown")
endif()
target_compile_definitions(app PRIVATE SB_GIT_REV="${sb_git_rev}")
target_sources(app PRIVATE
  src/main.c
  src/kernels.c
  src/integrity.c
  src/bench_cpu.c
  src/bench_access.c
  src/bench_stream.c
  src/retention.c
  src/bench_sustained.c
)
if(CONFIG_SDRAM_BENCH_DMA OR CONFIG_SDRAM_BENCH_CONCURRENT)
  target_sources(app PRIVATE src/bench_dma.c)
endif()
target_sources_ifdef(CONFIG_SDRAM_BENCH_CONCURRENT app PRIVATE src/bench_concurrent.c)

# Benchmark kernels at -O2; the rest of the image keeps the default -Os
get_target_property(app_sources app SOURCES)
set_source_files_properties(${app_sources} PROPERTIES COMPILE_OPTIONS -O2)
```

## Kconfig
```
# SPDX-License-Identifier: Apache-2.0

mainmenu "SDRAM benchmark"

menu "SDRAM benchmark options"

config SDRAM_BENCH_BUF_SIZE
	int "Benchmark buffer size in bytes"
	default 4194304
	range 1048576 4194304
	help
	  Bytes moved per throughput pass. It must be much larger than the
	  16 KiB Cortex-M85 data cache so that read passes are served by the
	  SDRAM, and must fit in one 4 MiB window of the SDRAM layout.

config SDRAM_BENCH_ITERATIONS
	int "Timed iterations per test"
	default 8
	range 1 64

config SDRAM_BENCH_INTEGRITY
	bool "Full-device integrity test before benchmarking"
	default y
	help
	  Data-bus, address-bus, address-as-data, inverted-address and
	  checkerboard tests over the complete SDRAM device. Throughput is
	  not measured if any of them fails.

config SDRAM_BENCH_INTEGRITY_PASSES
	int "Integrity test passes"
	default 1
	range 1 100
	depends on SDRAM_BENCH_INTEGRITY
	help
	  Each pass runs every integrity step; the random patterns use a new
	  seed per pass.

config SDRAM_BENCH_RETENTION_SEC
	int "Data retention test idle time in seconds (0 disables)"
	default 0
	range 0 86400
	help
	  Fill all of SDRAM, leave the bus idle (auto-refresh only) for this
	  time, then verify.

config SDRAM_BENCH_CPU
	bool "Sequential CPU read/write/copy suite"
	default y

config SDRAM_BENCH_ACCESS
	bool "Access-pattern suite"
	default y
	help
	  Mixed read/write, read-modify-write, random access, pointer-chase
	  latency, stride sweep, access-size sweep and block-size sweep.

config SDRAM_BENCH_DMA
	bool "DMAC memory-to-memory suite"
	select DMA
	help
	  SRAM-to-SDRAM, SDRAM-to-SRAM and SDRAM-to-SDRAM transfers on dma0
	  channel 0, with transfer-unit and block-size sweeps.

config SDRAM_BENCH_DMA_CHUNK
	int "DMA block size in bytes for the base DMA tests"
	default 131072
	range 4096 131072
	depends on SDRAM_BENCH_DMA
	help
	  Bytes moved per DMA block. The RA DMAC limits one block to 65535
	  transfers and the block must fit in the 128 KiB SRAM buffer.

config SDRAM_BENCH_CONCURRENT
	bool "Concurrent bus-master suite"
	select DMA
	help
	  CPU kernels measured alone and while the DMAC (dma0 channel 1) and,
	  if enabled, the CM33 and the GLCDC access the SDRAM.

config SDRAM_BENCH_CM33
	bool "CM33 traffic generator in the concurrent suite"
	depends on SDRAM_BENCH_CONCURRENT
	help
	  Starts the CM33 and drives the cm33_traffic image through the SDRAM
	  mailbox. Enabled by the sysbuild build, which also builds and
	  flashes the CM33 image.

config SDRAM_BENCH_GLCDC
	bool "GLCDC scan-out in the concurrent suite"
	depends on SDRAM_BENCH_CONCURRENT && DISPLAY
	help
	  Scans two application frame buffers in SDRAM out through the GLCDC
	  (requires the glcdc.overlay devicetree overlay and
	  CONFIG_RENESAS_RA_GLCDC_FB_NUM=0).

config SDRAM_BENCH_SUSTAINED_SEC
	int "Sustained test duration in seconds (0 disables)"
	default 0
	range 0 86400

config SDRAM_BENCH_SUSTAINED_FULL
	bool "Sustained test covers all of SDRAM with random patterns"
	help
	  Rotate over 15 4 MiB windows (all of SDRAM except the mailbox
	  window) and write a new pseudo-random pattern every cycle. Do not
	  combine with the concurrent suite.

config SDRAM_BENCH_SUSTAINED_REPORT_SEC
	int "Sustained test report interval in seconds"
	default 10
	range 1 3600

endmenu

source "Kconfig.zephyr"
```

## prj.conf
```kconfig
# SPDX-License-Identifier: Apache-2.0

CONFIG_GPIO=y
CONFIG_SERIAL=y
CONFIG_CONSOLE=y
CONFIG_UART_CONSOLE=y
# Also required for uart_renesas_ra8_sci_b.c to compile
CONFIG_UART_INTERRUPT_DRIVEN=y
CONFIG_PRINTK=y
CONFIG_PINCTRL=y

# External SDRAM controller
CONFIG_MEMC=y
CONFIG_MEMC_RENESAS_RA_SDRAM=y

# The RA8P1 SoC defaults leave the data cache disabled
CONFIG_DCACHE=y
CONFIG_CACHE_MANAGEMENT=y

# DWT cycle counter based timing
CONFIG_TIMING_FUNCTIONS=y

# CONFIG_SPEED_OPTIMIZATIONS is not used: at -O2 GCC emits FPU register loads in
# the FSP bsp_clock_init(), which runs before the FPU is enabled (NOCP HardFault).
# The benchmark sources are built with -O2 in CMakeLists.txt instead.

CONFIG_MAIN_STACK_SIZE=4096

# Keep CM33 halted: no second bus master, and no stale CPU1 image in MRAM
# that could reset the system during the run
CONFIG_SOC_RA_ENABLE_START_SECOND_CORE=n
```

## overlay-concurrent.conf
```kconfig
# SPDX-License-Identifier: Apache-2.0

# Concurrent bus-master suite only (integrity still runs first). The sysbuild
# build adds the CM33 traffic generator; glcdc.overlay with
# overlay-glcdc.conf adds GLCDC scan-out.
CONFIG_SDRAM_BENCH_CPU=n
CONFIG_SDRAM_BENCH_ACCESS=n
CONFIG_SDRAM_BENCH_CONCURRENT=y
```

## overlay-dma.conf
```kconfig
# SPDX-License-Identifier: Apache-2.0

# Add DMAC memory-to-memory throughput tests
CONFIG_SDRAM_BENCH_DMA=y
```

## overlay-glcdc.conf
```kconfig
# SPDX-License-Identifier: Apache-2.0

# GLCDC scan-out of application frame buffers in SDRAM (use with glcdc.overlay)
CONFIG_DISPLAY=y
CONFIG_RENESAS_RA_GLCDC_FB_NUM=0
CONFIG_SDRAM_BENCH_GLCDC=y
```

## overlay-integrity.conf
```kconfig
# SPDX-License-Identifier: Apache-2.0

# Integrity only: 3 passes of every integrity step, then a 300 s data
# retention test over all of SDRAM
CONFIG_SDRAM_BENCH_INTEGRITY_PASSES=3
CONFIG_SDRAM_BENCH_RETENTION_SEC=300
CONFIG_SDRAM_BENCH_CPU=n
CONFIG_SDRAM_BENCH_ACCESS=n
```

## overlay-stress.conf
```kconfig
# SPDX-License-Identifier: Apache-2.0

# 1 h full-device stress: 15 windows (60 MiB), new pseudo-random pattern per
# cycle (integrity still runs first)
CONFIG_SDRAM_BENCH_CPU=n
CONFIG_SDRAM_BENCH_ACCESS=n
CONFIG_SDRAM_BENCH_SUSTAINED_SEC=3600
CONFIG_SDRAM_BENCH_SUSTAINED_REPORT_SEC=30
CONFIG_SDRAM_BENCH_SUSTAINED_FULL=y
```

## overlay-sustained.conf
```kconfig
# SPDX-License-Identifier: Apache-2.0

# 10-minute sustained run (integrity still runs first)
CONFIG_SDRAM_BENCH_CPU=n
CONFIG_SDRAM_BENCH_ACCESS=n
CONFIG_SDRAM_BENCH_SUSTAINED_SEC=600
CONFIG_SDRAM_BENCH_SUSTAINED_REPORT_SEC=10
```

## glcdc.overlay
```dts
/* SPDX-License-Identifier: Apache-2.0 */

/*
 * GLCDC scan-out for the concurrent test: 1024x600 RGB565 at a 48 MHz pixel
 * clock (about 57.5 frames/s), the same video mode as lcd_display_test.
 * No panel, bridge or DSI host is enabled; only the GLCDC reads the frame
 * buffers from SDRAM. The application owns the frame buffers
 * (CONFIG_RENESAS_RA_GLCDC_FB_NUM=0).
 */

#include <zephyr/dt-bindings/display/panel.h>

&zephyr_lcdif {
	status = "okay";
	height = <600>;
	width = <1024>;
	input-pixel-format = <PANEL_PIXEL_FORMAT_RGB_565>;
	output-pixel-format = <PANEL_PIXEL_FORMAT_RGB_888>;
	ext-ram = <&sdram1>;
	output-clock-divisor = <5>;
	output-pin-hsync = "TCON_PIN_NONE";
	output-pin-vsync = "TCON_PIN_NONE";
	output-pin-de = "TCON_PIN_NONE";
	output-data-signal-polarity = "LOACTIVE";

	display-timings {
		compatible = "zephyr,panel-timing";
		hsync-len = <100>;
		hback-porch = <100>;
		hfront-porch = <100>;
		vsync-len = <10>;
		vback-porch = <10>;
		vfront-porch = <10>;
		hsync-active = <1>;
		vsync-active = <1>;
		de-active = <0>;
		pixelclk-active = <0>;
		clock-frequency = <48000000>;
	};
};
```

## boards/zcore_ra8p1_r7ka8p1kflcac_cm85.overlay
```dts
/* SPDX-License-Identifier: Apache-2.0 */

/*
 * The SDRAM controller and the sdram1 memory region are enabled by the
 * board dtsi. This overlay only enables DMAC channels 0-3 for the DMA
 * tests (channel 1 is also the background engine of the concurrent suite).
 * The node is unused when CONFIG_DMA is disabled.
 */

&dma0 {
	status = "okay";
	interrupts = <88 1>, <89 1>, <90 1>, <91 1>;
	interrupt-names = "ch0", "ch1", "ch2", "ch3";
};
```

## src/main.c
```c
/*
 * SPDX-License-Identifier: Apache-2.0
 *
 * SDRAM integrity and throughput benchmark for the EK-RA8P1 board.
 *
 * Results are printed on the console as a table and as RESULT,... CSV lines.
 * MB/s means 10^6 bytes per second.
 */

#include <zephyr/kernel.h>
#include <zephyr/cache.h>
#include <zephyr/timing/timing.h>
#include <cmsis_core.h>
#include <bsp_api.h>
#include <string.h>

#include "sdram_bench.h"

#define MAX_RESULTS 320U

struct bench_result {
	const char *group;
	const char *test;
	const char *cache;
	struct bench_stats st;
};

static struct bench_result results[MAX_RESULTS];
static uint32_t result_count;
static uint32_t peak_mbps;
static uint32_t warning_count;

void bench_add_warnings(uint32_t n)
{
	warning_count += n;
}

uint32_t bench_mbps_x10(uint64_t bytes, uint64_t ns)
{
	if (ns == 0U) {
		return 0U;
	}

	/* bytes / us = MB/s, scaled by 10 for one decimal */
	return (uint32_t)((bytes * 10000U) / ns);
}

void bench_stats_init(struct bench_stats *st, size_t bytes, uint32_t bus_mult, uint32_t ops)
{
	memset(st, 0, sizeof(*st));
	st->min_ns = UINT64_MAX;
	st->bytes = bytes;
	st->bus_mult = bus_mult;
	st->ops = ops;
}

void bench_stats_add(struct bench_stats *st, uint64_t ns)
{
	st->min_ns = MIN(st->min_ns, ns);
	st->max_ns = MAX(st->max_ns, ns);
	st->total_ns += ns;
	st->iters++;

	/* Welford update of the per-iteration throughput (MB/s) */
	if (ns != 0U) {
		const double mbps = ((double)st->bytes * 1000.0) / (double)ns;
		const double delta = mbps - st->mean_mbps;

		st->mean_mbps += delta / (double)st->iters;
		st->m2_mbps += delta * (mbps - st->mean_mbps);
	}
}

void bench_stats_add_pmu(struct bench_stats *st, const uint32_t pmu[PMU_EVENTS])
{
	if (!bench_pmu_ok()) {
		return;
	}
	for (size_t e = 0; e < PMU_EVENTS; e++) {
		st->pmu[e] += pmu[e];
	}
	st->pmu_valid = true;
}

/* Standard deviation of the per-iteration MB/s, x10 */
static uint32_t sd_x10(const struct bench_stats *st)
{
	double var;
	double sd = 0.0;

	if (st->iters < 2U) {
		return 0U;
	}

	var = st->m2_mbps / (double)(st->iters - 1U);
	/* Newton iteration; avoids pulling in libm for one square root */
	if (var > 0.0) {
		sd = var;
		for (int i = 0; i < 30; i++) {
			sd = 0.5 * (sd + (var / sd));
		}
	}

	return (uint32_t)((sd * 10.0) + 0.5);
}

/* Coefficient of variation in 0.01 % units */
static uint32_t cv_x100(const struct bench_stats *st)
{
	if (st->mean_mbps <= 0.0) {
		return 0U;
	}

	return (uint32_t)((((double)sd_x10(st) / 10.0) * 10000.0) / st->mean_mbps);
}

/* Average measured time per iteration in 0.01 ms */
static uint32_t time_x100ms(const struct bench_stats *st)
{
	return (st->iters == 0U) ? 0U : (uint32_t)(st->total_ns / st->iters / 10000U);
}

/* Average MiB/s x10 */
static uint32_t mibps_x10(const struct bench_stats *st)
{
	if (st->total_ns == 0U) {
		return 0U;
	}

	return (uint32_t)(((uint64_t)st->bytes * st->iters * 10U * 1000000000ULL) /
			  (st->total_ns * 1048576ULL));
}

/* Fastest iteration gives max MB/s, slowest gives min MB/s */
static void stats_mbps(const struct bench_stats *st, uint32_t *min, uint32_t *avg, uint32_t *max)
{
	*min = bench_mbps_x10(st->bytes, st->max_ns);
	*max = bench_mbps_x10(st->bytes, st->min_ns);
	*avg = (st->iters == 0U) ? 0U
				 : bench_mbps_x10((uint64_t)st->bytes * st->iters, st->total_ns);
}

static uint32_t pct_of_peak(const struct bench_stats *st, uint32_t avg_x10)
{
	/* (avg_x10 / 10) * bus_mult * 100 / peak */
	return (peak_mbps == 0U) ? 0U
				 : (uint32_t)(((uint64_t)avg_x10 * st->bus_mult * 10U) / peak_mbps);
}

/* Average time per access in 0.1 ns, 0 if the test has no access count */
static uint32_t ns_per_op_x10(const struct bench_stats *st)
{
	if ((st->ops == 0U) || (st->iters == 0U)) {
		return 0U;
	}

	return (uint32_t)((st->total_ns * 10U) / ((uint64_t)st->ops * st->iters));
}

void bench_section(const char *title)
{
	printk("\n--- %s ---\n", title);
	printk("%-7s %-26s %-5s %9s %9s %9s %6s %9s %6s %9s\n", "group", "test", "cache",
	       "min MB/s", "avg MB/s", "max MB/s", "%peak", "ns/op", "cv%", "ms/iter");
}

void bench_report(const char *group, const char *test, const char *cache,
		  const struct bench_stats *st)
{
	uint32_t min, avg, max;
	uint32_t nsop = ns_per_op_x10(st);
	uint32_t cv = cv_x100(st);
	uint32_t ms = time_x100ms(st);
	char pct[8] = "-";
	char ns[12] = "-";
	char cvs[16];
	char mss[16];

	stats_mbps(st, &min, &avg, &max);
	snprintk(cvs, sizeof(cvs), "%u.%02u%s", cv / 100U, cv % 100U, (cv > 500U) ? "!" : "");
	snprintk(mss, sizeof(mss), "%u.%02u", ms / 100U, ms % 100U);

	if (st->bus_mult != 0U) {
		snprintk(pct, sizeof(pct), "%u%%", pct_of_peak(st, avg));
	}
	if (nsop != 0U) {
		snprintk(ns, sizeof(ns), "%u.%u", nsop / 10U, nsop % 10U);
	}

	printk("%-7s %-26s %-5s %7u.%u %7u.%u %7u.%u %6s %9s %6s %9s\n", group, test, cache,
	       min / 10U, min % 10U, avg / 10U, avg % 10U, max / 10U, max % 10U, pct, ns, cvs,
	       mss);

	if (result_count < MAX_RESULTS) {
		results[result_count++] = (struct bench_result){
			.group = group, .test = test, .cache = cache, .st = *st};
	}
}

static void print_csv(void)
{
	printk("\nRESULT,group,test,cache,bytes,iters,min_MBps,avg_MBps,max_MBps,pct_of_peak,"
	       "ns_per_op,time_ms,MiBps,sd_MBps,cv_pct,pmu_refill,pmu_bus,pmu_mem,"
	       "pmu_stall_be,flag\n");
	for (uint32_t i = 0; i < result_count; i++) {
		const struct bench_result *r = &results[i];
		uint32_t min, avg, max;
		uint32_t nsop = ns_per_op_x10(&r->st);

		stats_mbps(&r->st, &min, &avg, &max);
		printk("RESULT,%s,%s,%s,%u,%u,%u.%u,%u.%u,%u.%u,", r->group, r->test, r->cache,
		       (uint32_t)r->st.bytes, r->st.iters, min / 10U, min % 10U, avg / 10U,
		       avg % 10U, max / 10U, max % 10U);
		if (r->st.bus_mult != 0U) {
			printk("%u,", pct_of_peak(&r->st, avg));
		} else {
			printk("-,");
		}
		if (nsop != 0U) {
			printk("%u.%u,", nsop / 10U, nsop % 10U);
		} else {
			printk("-,");
		}
		{
			const uint32_t ms = time_x100ms(&r->st);
			const uint32_t mib = mibps_x10(&r->st);
			const uint32_t sd = sd_x10(&r->st);
			const uint32_t cv = cv_x100(&r->st);

			printk("%u.%02u,%u.%u,%u.%u,%u.%02u,", ms / 100U, ms % 100U, mib / 10U,
			       mib % 10U, sd / 10U, sd % 10U, cv / 100U, cv % 100U);
			if (r->st.pmu_valid && (r->st.iters != 0U)) {
				for (size_t e = 0; e < PMU_EVENTS; e++) {
					printk("%u,", (uint32_t)(r->st.pmu[e] / r->st.iters));
				}
			} else {
				printk("-,-,-,-,");
			}
			printk("%s\n", (cv > 500U) ? "VAR" : "-");
		}
	}
}

const char *bench_cache_name(void)
{
	return bench_dcache_enabled() ? "on" : "off";
}

uint32_t bench_peak_mbps(void)
{
	return peak_mbps;
}

bool bench_dcache_enabled(void)
{
	return (SCB->CCR & SCB_CCR_DC_Msk) != 0U;
}

void bench_dcache_set(bool on)
{
	if (!IS_ENABLED(CONFIG_DCACHE) || (on == bench_dcache_enabled())) {
		return;
	}

	if (on) {
		sys_cache_data_enable();
	} else {
		sys_cache_data_disable();
	}
}

void bench_cache_sync(void)
{
	if (bench_dcache_enabled()) {
		(void)sys_cache_data_flush_and_invd_all();
	}
}

static void print_dcache_geometry(void)
{
	uint32_t ccsidr;
	uint32_t line, ways, sets;

	SCB->CSSELR = 0U; /* level 1 data cache */
	__DSB();
	ccsidr = SCB->CCSIDR;
	line = 1U << (((ccsidr & SCB_CCSIDR_LINESIZE_Msk) >> SCB_CCSIDR_LINESIZE_Pos) + 4U);
	ways = CCSIDR_WAYS(ccsidr) + 1U;
	sets = CCSIDR_SETS(ccsidr) + 1U;

	printk("D-cache        : %u KiB (%u sets x %u ways x %u B), %s, %s\n",
	       (line * ways * sets) / 1024U, sets, ways, line,
	       bench_dcache_enabled() ? "enabled" : "disabled",
	       IS_ENABLED(CONFIG_CPU_RA_DCACHE_WRITEBACK) ? "write-back" : "write-through");
}

/* Controller configuration as programmed by the memc driver */
static void print_sdramc(void)
{
	static const char *const bl_names[8] = {"1", "2", "4", "8", "rsvd", "rsvd", "rsvd",
						"page"};
	const uint32_t sdtr = R_BUS->SDRAM.SDTR;
	const uint32_t mr = R_BUS->SDRAM.SDMOD;

	printk("SDRAMC         : SDCCR=0x%02x SDCMOD=0x%02x SDAMOD=0x%02x SDADR=0x%02x "
	       "SDTR=0x%08x SDMOD=0x%04x SDRFCR=0x%04x SDRFEN=0x%02x SDSR=0x%02x\n",
	       R_BUS->SDRAM.SDCCR, R_BUS->SDRAM.SDCMOD, R_BUS->SDRAM.SDAMOD, R_BUS->SDRAM.SDADR,
	       sdtr, mr, R_BUS->SDRAM.SDRFCR, R_BUS->SDRAM.SDRFEN, R_BUS->SDRAM.SDSR);
	printk("SDRAM timing   : CL=%u tRCD=%u tRP=%u tWR=%u tRAS=%u (SDCLK), mode register "
	       "burst length %s, CAS latency %u, refresh count %u\n",
	       (uint32_t)((sdtr & R_BUS_SDRAM_SDTR_CL_Msk) >> R_BUS_SDRAM_SDTR_CL_Pos),
	       (uint32_t)(((sdtr & R_BUS_SDRAM_SDTR_RCD_Msk) >> R_BUS_SDRAM_SDTR_RCD_Pos) + 1U),
	       (uint32_t)(((sdtr & R_BUS_SDRAM_SDTR_RP_Msk) >> R_BUS_SDRAM_SDTR_RP_Pos) + 1U),
	       (uint32_t)(((sdtr & R_BUS_SDRAM_SDTR_WR_Msk) >> R_BUS_SDRAM_SDTR_WR_Pos) + 1U),
	       (uint32_t)(((sdtr & R_BUS_SDRAM_SDTR_RAS_Msk) >> R_BUS_SDRAM_SDTR_RAS_Pos) + 1U),
	       bl_names[mr & 0x7U], (mr >> 4) & 0x7U,
	       (uint32_t)(((R_BUS->SDRAM.SDRFCR & R_BUS_SDRAM_SDRFCR_RFC_Msk) >>
			   R_BUS_SDRAM_SDRFCR_RFC_Pos) +
			  1U));
}

static void print_banner(void)
{
	uint32_t bclk = R_FSP_SystemClockHzGet(FSP_PRIV_CLOCK_BCLK);

	/* SDCLK runs at BCLK; the 32-bit bus moves 4 bytes per SDCLK */
	peak_mbps = (uint32_t)(((uint64_t)bclk * SDRAM_BUS_BYTES) / 1000000U);

	printk("\n*** sdram_benchmark: %s ***\n", CONFIG_BOARD_TARGET);
	printk("Firmware       : %s, built %s %s\n", SB_GIT_REV, __DATE__, __TIME__);
	printk("CPU clock      : %u Hz (timing counter %u Hz)\n", SystemCoreClock,
	       (uint32_t)timing_freq_get());
	printk("BCLK / SDCLK   : %u Hz (SDCKOCR=0x%02x BCKCR=0x%02x)\n", bclk,
	       R_SYSTEM->SDCKOCR, R_SYSTEM->BCKCR);
	printk("SDRAM          : 0x%08x, %u MiB, %u-bit bus\n", (uint32_t)SDRAM_BASE,
	       (uint32_t)(SDRAM_SIZE / (1024U * 1024U)), SDRAM_BUS_BYTES * 8U);
	printk("SDRAM type     : SDR, 1 transfer/clock, %u MT/s\n", bclk / 1000000U);
	printk("Theoretical    : %u MB/s = %u bit / 8 x %u MHz x 1 transfer/clock\n", peak_mbps,
	       SDRAM_BUS_BYTES * 8U, bclk / 1000000U);
	print_sdramc();
	print_dcache_geometry();
	printk("Windows        : A=0x%08x B=0x%08x C=0x%08x D=0x%08x, %u KiB per pass, "
	       "%u iterations\n",
	       SB_WIN_A, SB_WIN_B, SB_WIN_C, SB_WIN_D, (uint32_t)(BENCH_BUF_SIZE / 1024U),
	       BENCH_ITER);
	printk("Other regions  : FB0=0x%08x FB1=0x%08x CM33=0x%08x/0x%08x mailbox=0x%08x\n",
	       SB_FB0, SB_FB1, SB_CM33_SRC, SB_CM33_DST, SB_MBOX_ADDR);
	printk("SRAM buffer    : 0x%08x, %u KiB\n", (uint32_t)(uintptr_t)bench_sram_buf,
	       SRAM_BUF_SIZE / 1024U);
	printk("Suites         : integrity=%s cpu=%s access=%s dma=%s concurrent=%s cm33=%s "
	       "glcdc=%s sustained=%u s\n",
	       IS_ENABLED(CONFIG_SDRAM_BENCH_INTEGRITY) ? "y" : "n",
	       IS_ENABLED(CONFIG_SDRAM_BENCH_CPU) ? "y" : "n",
	       IS_ENABLED(CONFIG_SDRAM_BENCH_ACCESS) ? "y" : "n",
	       IS_ENABLED(CONFIG_SDRAM_BENCH_DMA) ? "y" : "n",
	       IS_ENABLED(CONFIG_SDRAM_BENCH_CONCURRENT) ? "y" : "n",
	       IS_ENABLED(CONFIG_SDRAM_BENCH_CM33) ? "y" : "n",
	       IS_ENABLED(CONFIG_SDRAM_BENCH_GLCDC) ? "y" : "n",
	       (uint32_t)CONFIG_SDRAM_BENCH_SUSTAINED_SEC);
	printk("Integrity      : %u pass(es), retention %u s\n",
	       (uint32_t)CONFIG_SDRAM_BENCH_INTEGRITY_PASSES,
	       (uint32_t)CONFIG_SDRAM_BENCH_RETENTION_SEC);
	printk("Units          : MB/s = 10^6 bytes/s (MiB/s in CSV); %%peak = avg x SDRAM bus "
	       "bytes per byte / theoretical; ns/op = average time per access; cv%% = "
	       "stddev/mean of per-iteration MB/s, '!' above 5%%\n");
}

int main(void)
{
	uint32_t failures = 0U;

	timing_init();
	timing_start();

	bench_pmu_init();
	print_banner();

	if (IS_ENABLED(CONFIG_SDRAM_BENCH_INTEGRITY)) {
		failures += sdram_integrity_run();
		if (failures != 0U) {
			printk("\nIntegrity failed, throughput not measured\n");
			goto out;
		}
	}

	if (CONFIG_SDRAM_BENCH_RETENTION_SEC > 0) {
		failures += sdram_retention_run();
	}

	if (IS_ENABLED(CONFIG_SDRAM_BENCH_CPU)) {
		failures += bench_cpu_run();
	}

	/* Random-write and chase tests cover all of SDRAM, so they run before
	 * any other bus master uses its region.
	 */
	if (IS_ENABLED(CONFIG_SDRAM_BENCH_ACCESS)) {
		failures += bench_access_run();
		failures += bench_stream_run();
	}

	if (IS_ENABLED(CONFIG_SDRAM_BENCH_DMA)) {
		failures += bench_dma_run();
	}

	if (IS_ENABLED(CONFIG_SDRAM_BENCH_CONCURRENT)) {
		failures += bench_concurrent_run();
	}

	if (CONFIG_SDRAM_BENCH_SUSTAINED_SEC > 0) {
		failures += bench_sustained_run();
	}

	print_csv();

out:
	timing_stop();
	printk("\nsdram_benchmark %s (%u failures, %u warnings)\n",
	       (failures == 0U) ? "PASSED" : "FAILED", failures, warning_count);

	return 0;
}
```

## include/sdram_bench_shared.h
```c
/*
 * SPDX-License-Identifier: Apache-2.0
 *
 * SDRAM layout and CM85 <-> CM33 mailbox shared by the sdram_benchmark
 * (CM85) and cm33_traffic (CM33) images.
 */

#ifndef SDRAM_BENCH_SHARED_H_
#define SDRAM_BENCH_SHARED_H_

#include <stdint.h>

#define SB_SDRAM_BASE 0x68000000U
#define SB_SDRAM_SIZE 0x04000000U
#define SB_MIB        0x00100000U

/* 4 MiB windows; see README "SDRAM layout" */
#define SB_WIN_SIZE   (4U * SB_MIB)
#define SB_WIN_A      (SB_SDRAM_BASE + (0U * SB_MIB))  /* CPU primary */
#define SB_WIN_B      (SB_SDRAM_BASE + (4U * SB_MIB))  /* CPU copy target */
#define SB_WIN_C      (SB_SDRAM_BASE + (8U * SB_MIB))  /* background DMA source */
#define SB_WIN_D      (SB_SDRAM_BASE + (12U * SB_MIB)) /* background DMA target */
#define SB_FB0        (SB_SDRAM_BASE + (16U * SB_MIB)) /* GLCDC frame buffers */
#define SB_FB1        (SB_SDRAM_BASE + (18U * SB_MIB))
#define SB_CM33_SRC   (SB_SDRAM_BASE + (32U * SB_MIB)) /* CM33 traffic source */
#define SB_CM33_DST   (SB_SDRAM_BASE + (36U * SB_MIB)) /* CM33 copy target */
#define SB_MBOX_ADDR  (SB_SDRAM_BASE + SB_SDRAM_SIZE - 4096U)

/* CM33 moves data in blocks of this size and counts completed blocks */
#define SB_CM33_BLOCK 16384U
#define SB_CM33_MAGIC 0x33A5C0DEU

enum sb_cm33_cmd {
	SB_CMD_IDLE = 0,
	SB_CMD_READ = 1,
	SB_CMD_WRITE = 2,
	SB_CMD_COPY = 3,
};

/*
 * Each side writes only its own 32-byte line, so the CM85 can clean its
 * line and invalidate the CM33 line without losing data in either cache
 * write policy. The CM33 has no data cache.
 */
struct sb_mbox_ctl {
	volatile uint32_t cmd;
	volatile uint32_t seq;
	uint32_t reserved[6];
};

struct sb_mbox_status {
	volatile uint32_t magic;
	volatile uint32_t ack;    /* last ctl.seq the CM33 has switched to */
	volatile uint32_t blocks; /* blocks completed since the last command change */
	volatile uint32_t errors; /* CM33 copy verification failures */
	volatile uint32_t sink;
	uint32_t reserved[3];
};

struct sb_mbox {
	struct sb_mbox_ctl ctl;
	struct sb_mbox_status st;
};

#define SB_MBOX ((struct sb_mbox *)SB_MBOX_ADDR)

#endif /* SDRAM_BENCH_SHARED_H_ */
```

## src/bench_access.c
```c
/*
 * SPDX-License-Identifier: Apache-2.0
 *
 * Access-pattern suite: mixed read/write, read-modify-write, random access,
 * pointer-chase latency, stride sweep, access-size sweep and block-size sweep.
 */

#include <zephyr/kernel.h>
#include <string.h>

#include "sdram_bench.h"

#define RAND_OPS     262144U
#define RAND_SEED    0x2545F491U
#define CHASE_HOPS   65536U
#define CHASE_STRIDE 64U
#define STRIDE_OPS   65536U
#define BLOCK_TOTAL  BENCH_BUF_SIZE
#define SMALL_WIN    (16U * 1024U)

static ALWAYS_INLINE uint32_t xorshift32(uint32_t x)
{
	x ^= x << 13;
	x ^= x >> 17;
	x ^= x << 5;
	return x;
}

/* ---- mixed read/write: per 8-word group, R reads from src and 8-R writes to dst ---- */

static ALWAYS_INLINE void mix(const struct bench_kernel *k, const uint32_t reads)
{
	volatile const uint32_t *s = k->src;
	volatile uint32_t *d = k->dst;
	const size_t n = k->len / sizeof(uint32_t);
	uint32_t acc = 0U;

	for (size_t i = 0; i < n; i += 8U) {
		for (uint32_t r = 0; r < reads; r++) {
			acc += s[i + r];
		}
		for (uint32_t w = reads; w < 8U; w++) {
			d[i + w] = PAT32(i + w);
		}
	}
	bench_sink = acc;
}

static void k_mix_r6w2(const struct bench_kernel *k)
{
	mix(k, 6U);
}

static void k_mix_r4w4(const struct bench_kernel *k)
{
	mix(k, 4U);
}

static void k_mix_r2w6(const struct bench_kernel *k)
{
	mix(k, 2U);
}

static bool verify_mix(const struct bench_kernel *k, uint32_t calls)
{
	const uint32_t *d = k->dst;

	ARG_UNUSED(calls);

	for (size_t i = 0; i < k->len / sizeof(uint32_t); i += 8U) {
		for (uint32_t w = k->param; w < 8U; w++) {
			if (d[i + w] != PAT32(i + w)) {
				printk("    verify %s @0x%08x failed\n", k->name,
				       (uint32_t)(uintptr_t)&d[i + w]);
				return false;
			}
		}
	}

	return true;
}

/* ---- read-modify-write: p[i] += 1 ---- */

static void k_rmw32(const struct bench_kernel *k)
{
	volatile uint32_t *p = k->dst;
	const size_t n = k->len / sizeof(uint32_t);

	for (size_t i = 0; i < n; i += 4U) {
		p[i + 0U] = p[i + 0U] + 1U;
		p[i + 1U] = p[i + 1U] + 1U;
		p[i + 2U] = p[i + 2U] + 1U;
		p[i + 3U] = p[i + 3U] + 1U;
	}
}

static void setup_rmw(const struct bench_kernel *k)
{
	k_write32(k);
	bench_cache_sync();
}

static bool verify_rmw(const struct bench_kernel *k, uint32_t calls)
{
	const uint32_t *p = k->dst;

	for (size_t i = 0; i < k->len / sizeof(uint32_t); i++) {
		if (p[i] != (PAT32(i) + calls)) {
			printk("    verify %s @0x%08x: 0x%08x != 0x%08x\n", k->name,
			       (uint32_t)(uintptr_t)&p[i], p[i], PAT32(i) + calls);
			return false;
		}
	}

	return true;
}

/* ---- random access: param accesses at xorshift32 word indices within len ---- */

static void k_rand_read32(const struct bench_kernel *k)
{
	volatile const uint32_t *p = k->src;
	const uint32_t mask = (uint32_t)(k->len / sizeof(uint32_t)) - 1U;
	uint32_t x = RAND_SEED;
	uint32_t acc = 0U;

	for (uint32_t i = 0; i < k->param; i++) {
		x = xorshift32(x);
		acc += p[x & mask];
	}
	bench_sink = acc;
}

static void k_rand_write32(const struct bench_kernel *k)
{
	volatile uint32_t *p = k->dst;
	const uint32_t mask = (uint32_t)(k->len / sizeof(uint32_t)) - 1U;
	const uint32_t count = k->param;
	uint32_t x = RAND_SEED;

	for (uint32_t i = 0; i < count; i++) {
		x = xorshift32(x);
		p[x & mask] = PAT32(x & mask);
	}
}

/* The written value depends only on the index, so repeated hits are harmless */
static bool verify_rand_write(const struct bench_kernel *k, uint32_t calls)
{
	const uint32_t *p = k->dst;
	const uint32_t mask = (uint32_t)(k->len / sizeof(uint32_t)) - 1U;
	uint32_t x = RAND_SEED;

	ARG_UNUSED(calls);

	for (uint32_t i = 0; i < k->param; i++) {
		x = xorshift32(x);
		if (p[x & mask] != PAT32(x & mask)) {
			printk("    verify %s @0x%08x failed\n", k->name,
			       (uint32_t)(uintptr_t)&p[x & mask]);
			return false;
		}
	}

	return true;
}

/* ---- pointer chase: dependent loads over a full-period LCG permutation ---- */

static void setup_chase(const struct bench_kernel *k)
{
	const uintptr_t base = (uintptr_t)k->src;
	const uint32_t nodes = (uint32_t)(k->len / CHASE_STRIDE);

	for (uint32_t i = 0; i < nodes; i++) {
		/* Hull-Dobell: c odd and a = 1 mod 4 give period 2^n */
		uint32_t next = ((i * 1664525U) + 1013904223U) & (nodes - 1U);

		*(volatile uint32_t *)(base + (i * CHASE_STRIDE)) =
			(uint32_t)(base + (next * CHASE_STRIDE));
	}
	bench_cache_sync();
}

static void k_chase(const struct bench_kernel *k)
{
	uint32_t p = (uint32_t)(uintptr_t)k->src;

	for (uint32_t i = 0; i < k->param; i++) {
		p = *(volatile const uint32_t *)p;
	}
	bench_sink = p;
}

/* ---- stride: one 32-bit read every param bytes ---- */

static void k_stride_read32(const struct bench_kernel *k)
{
	const uintptr_t base = (uintptr_t)k->src;
	const uint32_t stride = k->param;
	uint32_t acc = 0U;

	for (uint32_t i = 0; i < k->ops; i++) {
		acc += *(volatile const uint32_t *)(base + (i * stride));
	}
	bench_sink = acc;
}

/* ---- access size ---- */

static void k_write8(const struct bench_kernel *k)
{
	volatile uint8_t *p = k->dst;
	/* Local copy: volatile byte stores may alias *k and force a reload */
	const size_t len = k->len;

	for (size_t i = 0; i < len; i += 4U) {
		p[i + 0U] = (uint8_t)(i + 0U);
		p[i + 1U] = (uint8_t)(i + 1U);
		p[i + 2U] = (uint8_t)(i + 2U);
		p[i + 3U] = (uint8_t)(i + 3U);
	}
}

static bool verify_write8(const struct bench_kernel *k, uint32_t calls)
{
	const uint8_t *p = k->dst;

	ARG_UNUSED(calls);

	for (size_t i = 0; i < k->len; i++) {
		if (p[i] != (uint8_t)i) {
			return false;
		}
	}

	return true;
}

static void k_write16(const struct bench_kernel *k)
{
	volatile uint16_t *p = k->dst;
	const size_t n = k->len / sizeof(uint16_t);

	for (size_t i = 0; i < n; i += 4U) {
		p[i + 0U] = (uint16_t)(i + 0U);
		p[i + 1U] = (uint16_t)(i + 1U);
		p[i + 2U] = (uint16_t)(i + 2U);
		p[i + 3U] = (uint16_t)(i + 3U);
	}
}

static bool verify_write16(const struct bench_kernel *k, uint32_t calls)
{
	const uint16_t *p = k->dst;

	ARG_UNUSED(calls);

	for (size_t i = 0; i < k->len / sizeof(uint16_t); i++) {
		if (p[i] != (uint16_t)i) {
			return false;
		}
	}

	return true;
}

static void k_read8(const struct bench_kernel *k)
{
	volatile const uint8_t *p = k->src;
	uint32_t acc = 0U;

	for (size_t i = 0; i < k->len; i += 4U) {
		acc += p[i + 0U];
		acc += p[i + 1U];
		acc += p[i + 2U];
		acc += p[i + 3U];
	}
	bench_sink = acc;
}

static void k_read16(const struct bench_kernel *k)
{
	volatile const uint16_t *p = k->src;
	const size_t n = k->len / sizeof(uint16_t);
	uint32_t acc = 0U;

	for (size_t i = 0; i < n; i += 4U) {
		acc += p[i + 0U];
		acc += p[i + 1U];
		acc += p[i + 2U];
		acc += p[i + 3U];
	}
	bench_sink = acc;
}

static const uint32_t stm_pattern[8] = {
	0x01234567U, 0x89ABCDEFU, 0xFEDCBA98U, 0x76543210U,
	0x0F1E2D3CU, 0x4B5A6978U, 0x8796A5B4U, 0xC3D2E1F0U,
};

/* 8-word LDM: one 32-byte block per instruction */
static void k_read_ldm(const struct bench_kernel *k)
{
	const uint32_t *p = k->src;
	const uint32_t *end = (const uint32_t *)((const uint8_t *)k->src + k->len);

	__asm__ volatile("1:\n"
			 "ldmia %[p]!, {r2, r3, r4, r5, r6, r8, r10, r12}\n"
			 "cmp %[p], %[end]\n"
			 "blo 1b\n"
			 : [p] "+r"(p)
			 : [end] "r"(end)
			 : "r2", "r3", "r4", "r5", "r6", "r8", "r10", "r12", "cc", "memory");
}

/* 8-word STM: one 32-byte block per instruction */
static void k_write_stm(const struct bench_kernel *k)
{
	uint32_t *p = k->dst;
	uint32_t *end = (uint32_t *)((uint8_t *)k->dst + k->len);

	__asm__ volatile("ldmia %[pat], {r2, r3, r4, r5, r6, r8, r10, r12}\n"
			 "1:\n"
			 "stmia %[p]!, {r2, r3, r4, r5, r6, r8, r10, r12}\n"
			 "cmp %[p], %[end]\n"
			 "blo 1b\n"
			 : [p] "+r"(p)
			 : [end] "r"(end), [pat] "r"(stm_pattern)
			 : "r2", "r3", "r4", "r5", "r6", "r8", "r10", "r12", "cc", "memory");
}

static bool verify_stm(const struct bench_kernel *k, uint32_t calls)
{
	const uint32_t *p = k->dst;

	ARG_UNUSED(calls);

	for (size_t i = 0; i < k->len / sizeof(uint32_t); i++) {
		if (p[i] != stm_pattern[i % 8U]) {
			return false;
		}
	}

	return true;
}

/* ---- block size: param-byte blocks at random block-aligned SDRAM offsets ---- */

static ALWAYS_INLINE uintptr_t block_addr(uint32_t *x, uint32_t block)
{
	*x = xorshift32(*x);
	return SDRAM_BASE + ((*x & ((uint32_t)(SDRAM_SIZE / block) - 1U)) * block);
}

static void k_block_read(const struct bench_kernel *k)
{
	const uint32_t block = k->param;
	uint32_t x = RAND_SEED;
	uint64_t acc = 0U;

	for (size_t done = 0; done < k->len; done += block) {
		volatile const uint64_t *p = (volatile const uint64_t *)block_addr(&x, block);

		for (uint32_t i = 0; i < block / sizeof(uint64_t); i += 4U) {
			acc += p[i + 0U];
			acc += p[i + 1U];
			acc += p[i + 2U];
			acc += p[i + 3U];
		}
	}
	bench_sink = acc;
}

static void k_block_write(const struct bench_kernel *k)
{
	const uint32_t block = k->param;
	const size_t len = k->len;
	uint32_t x = RAND_SEED;

	for (size_t done = 0; done < len; done += block) {
		uintptr_t a = block_addr(&x, block);
		volatile uint64_t *p = (volatile uint64_t *)a;
		const uint64_t v = PAT64(a);

		for (uint32_t i = 0; i < block / sizeof(uint64_t); i += 4U) {
			p[i + 0U] = v;
			p[i + 1U] = v;
			p[i + 2U] = v;
			p[i + 3U] = v;
		}
	}
}

static bool verify_block_write(const struct bench_kernel *k, uint32_t calls)
{
	const uint32_t block = k->param;
	uint32_t x = RAND_SEED;

	ARG_UNUSED(calls);

	for (size_t done = 0; done < k->len; done += block) {
		uintptr_t a = block_addr(&x, block);
		const uint64_t *p = (const uint64_t *)a;

		for (uint32_t i = 0; i < block / sizeof(uint64_t); i++) {
			if (p[i] != PAT64(a)) {
				printk("    verify %s @0x%08x failed\n", k->name, (uint32_t)a);
				return false;
			}
		}
	}

	return true;
}

/* ---- alternating regions: two line-strided streams param bytes apart ---- */

#define ALT_OPS    65536U
#define ALT_STRIDE 32U

static void k_alternate(const struct bench_kernel *k)
{
	const uintptr_t a = (uintptr_t)k->src;
	const uintptr_t b = a + k->param;
	uint32_t acc = 0U;

	for (uint32_t i = 0; i < ALT_OPS / 2U; i++) {
		acc += *(volatile const uint32_t *)(a + (i * ALT_STRIDE));
		acc += *(volatile const uint32_t *)(b + (i * ALT_STRIDE));
	}
	bench_sink = acc;
}

/* ---- alignment: 32-bit accesses at byte offset param, 64-bit at 0 or 4 ---- */

typedef uint32_t __aligned(1) u32_unaligned;

static void k_read32_off(const struct bench_kernel *k)
{
	volatile const u32_unaligned *p =
		(volatile const u32_unaligned *)((const uint8_t *)k->src + k->param);
	const size_t n = (k->len / sizeof(uint32_t)) - 1U;
	uint32_t acc = 0U;

	for (size_t i = 0; i < n; i += 4U) {
		acc += p[i + 0U];
		acc += p[i + 1U];
		acc += p[i + 2U];
		acc += p[i + 3U];
	}
	bench_sink = acc;
}

static void k_write32_off(const struct bench_kernel *k)
{
	volatile u32_unaligned *p = (volatile u32_unaligned *)((uint8_t *)k->dst + k->param);
	const size_t n = (k->len / sizeof(uint32_t)) - 1U;

	for (size_t i = 0; i < n; i += 4U) {
		p[i + 0U] = PAT32(i + 0U);
		p[i + 1U] = PAT32(i + 1U);
		p[i + 2U] = PAT32(i + 2U);
		p[i + 3U] = PAT32(i + 3U);
	}
}

static bool verify_write32_off(const struct bench_kernel *k, uint32_t calls)
{
	const u32_unaligned *p = (const u32_unaligned *)((const uint8_t *)k->dst + k->param);
	const size_t n = (k->len / sizeof(uint32_t)) - 1U;

	ARG_UNUSED(calls);

	for (size_t i = 0; i < (n & ~(size_t)3U); i++) {
		if (p[i] != PAT32(i)) {
			printk("    verify %s @0x%08x failed\n", k->name,
			       (uint32_t)(uintptr_t)&p[i]);
			return false;
		}
	}

	return true;
}

/* LDRD/STRD need word alignment: offsets 0 (8-aligned) and 4 (only word-aligned) */
static void k_read64_off(const struct bench_kernel *k)
{
	volatile const uint64_t *p =
		(volatile const uint64_t *)((const uint8_t *)k->src + k->param);
	const size_t n = (k->len / sizeof(uint64_t)) - 1U;
	uint64_t acc = 0U;

	for (size_t i = 0; i < (n & ~(size_t)3U); i += 4U) {
		acc += p[i + 0U];
		acc += p[i + 1U];
		acc += p[i + 2U];
		acc += p[i + 3U];
	}
	bench_sink = acc;
}

static void k_write64_off(const struct bench_kernel *k)
{
	volatile uint64_t *p = (volatile uint64_t *)((uint8_t *)k->dst + k->param);
	const uint32_t n = (uint32_t)((k->len / sizeof(uint64_t)) - 1U) & ~3U;

	for (uint32_t i = 0; i < n; i += 4U) {
		p[i + 0U] = PAT64(i + 0U);
		p[i + 1U] = PAT64(i + 1U);
		p[i + 2U] = PAT64(i + 2U);
		p[i + 3U] = PAT64(i + 3U);
	}
}

static bool verify_write64_off(const struct bench_kernel *k, uint32_t calls)
{
	const uint64_t *p = (const uint64_t *)((const uint8_t *)k->dst + k->param);
	const uint32_t n = (uint32_t)((k->len / sizeof(uint64_t)) - 1U) & ~3U;

	ARG_UNUSED(calls);

	for (uint32_t i = 0; i < n; i++) {
		if (p[i] != PAT64(i)) {
			printk("    verify %s @0x%08x failed\n", k->name,
			       (uint32_t)(uintptr_t)&p[i]);
			return false;
		}
	}

	return true;
}

/* ---- working-set sweep: copy uses the two halves of the set ---- */

static void k_copy64_half(const struct bench_kernel *k)
{
	const struct bench_kernel c = {
		.dst = (uint8_t *)k->dst + (k->len / 2U), .src = k->src, .len = k->len / 2U};

	k_copy64(&c);
}

static bool verify_copy_half(const struct bench_kernel *k, uint32_t calls)
{
	ARG_UNUSED(calls);

	return memcmp((const uint8_t *)k->dst + (k->len / 2U), k->src, k->len / 2U) == 0;
}

/* ---- test tables ---- */

#define FULL ((void *)SDRAM_BASE)

static const struct bench_kernel mixed_tests[] = {
	{.group = "mixed", .name = "mix_r75_w25", .fn = k_mix_r6w2, .dst = BENCH_SDRAM_B,
	 .src = BENCH_SDRAM_A, .len = BENCH_BUF_SIZE, .bus_mult = 1U, .param = 6U,
	 .writes_sdram = true, .verify = verify_mix},
	{.group = "mixed", .name = "mix_r50_w50", .fn = k_mix_r4w4, .dst = BENCH_SDRAM_B,
	 .src = BENCH_SDRAM_A, .len = BENCH_BUF_SIZE, .bus_mult = 1U, .param = 4U,
	 .writes_sdram = true, .verify = verify_mix},
	{.group = "mixed", .name = "mix_r25_w75", .fn = k_mix_r2w6, .dst = BENCH_SDRAM_B,
	 .src = BENCH_SDRAM_A, .len = BENCH_BUF_SIZE, .bus_mult = 1U, .param = 2U,
	 .writes_sdram = true, .verify = verify_mix},
	{.group = "mixed", .name = "rmw32", .fn = k_rmw32, .dst = BENCH_SDRAM_A,
	 .len = BENCH_BUF_SIZE, .bus_mult = 2U, .writes_sdram = true, .setup = setup_rmw,
	 .verify = verify_rmw},
};

#define RAND_READ(_name, _base, _len, _warm)                                                       \
	{.group = "random", .name = _name, .fn = k_rand_read32, .src = _base, .len = _len,         \
	 .bytes = RAND_OPS * 4U, .ops = RAND_OPS, .bus_mult = 1U, .param = RAND_OPS,               \
	 .warm = _warm}
#define RAND_WRITE(_name, _base, _len)                                                             \
	{.group = "random", .name = _name, .fn = k_rand_write32, .dst = _base, .len = _len,        \
	 .bytes = RAND_OPS * 4U, .ops = RAND_OPS, .bus_mult = 1U, .param = RAND_OPS,               \
	 .writes_sdram = true, .verify = verify_rand_write}
#define CHASE(_name, _base, _len, _warm)                                                           \
	{.group = "latency", .name = _name, .fn = k_chase, .src = _base, .len = _len,              \
	 .bytes = CHASE_HOPS * 4U, .ops = CHASE_HOPS, .param = CHASE_HOPS, .warm = _warm,          \
	 .setup = setup_chase}

static const struct bench_kernel random_tests[] = {
	RAND_READ("rand_read32_16k", BENCH_SDRAM_A, SMALL_WIN, true),
	RAND_READ("rand_read32_4m", BENCH_SDRAM_A, SB_WIN_SIZE, false),
	RAND_READ("rand_read32_64m", FULL, SDRAM_SIZE, false),
	RAND_WRITE("rand_write32_4m", BENCH_SDRAM_A, SB_WIN_SIZE),
	RAND_WRITE("rand_write32_64m", FULL, SDRAM_SIZE),
	CHASE("chase_16k", BENCH_SDRAM_A, SMALL_WIN, true),
	CHASE("chase_4m", BENCH_SDRAM_A, SB_WIN_SIZE, false),
	CHASE("chase_64m", FULL, SDRAM_SIZE, false),
};

#define STRIDE(_s)                                                                                 \
	{.group = "stride", .name = "stride_" #_s, .fn = k_stride_read32, .src = FULL,             \
	 .len = MIN((size_t)STRIDE_OPS * (_s), SDRAM_SIZE),                                        \
	 .bytes = MIN((size_t)STRIDE_OPS, SDRAM_SIZE / (_s)) * 4U,                                 \
	 .ops = MIN(STRIDE_OPS, (uint32_t)(SDRAM_SIZE / (_s))), .bus_mult = 1U, .param = (_s)}

static const struct bench_kernel stride_tests[] = {
	STRIDE(4),    STRIDE(8),     STRIDE(16),    STRIDE(32),   STRIDE(64),
	STRIDE(128),  STRIDE(256),   STRIDE(512),   STRIDE(1024), STRIDE(2048),
	STRIDE(4096), STRIDE(8192),  STRIDE(16384), STRIDE(65536), STRIDE(262144),
};

#define SIZE_RD(_name, _fn)                                                                        \
	{.group = "size", .name = _name, .fn = _fn, .src = BENCH_SDRAM_A, .len = BENCH_BUF_SIZE,   \
	 .bus_mult = 1U}
#define SIZE_WR(_name, _fn, _verify)                                                               \
	{.group = "size", .name = _name, .fn = _fn, .dst = BENCH_SDRAM_A, .len = BENCH_BUF_SIZE,   \
	 .bus_mult = 1U, .writes_sdram = true, .verify = _verify}

static const struct bench_kernel size_tests[] = {
	SIZE_RD("read8", k_read8),
	SIZE_RD("read16", k_read16),
	SIZE_RD("read32", k_read32),
	SIZE_RD("read64", k_read64),
	SIZE_RD("read_ldm8x32", k_read_ldm),
	SIZE_WR("write8", k_write8, verify_write8),
	SIZE_WR("write16", k_write16, verify_write16),
	SIZE_WR("write32", k_write32, verify_write32),
	SIZE_WR("write64", k_write64, verify_write64),
	SIZE_WR("write_stm8x32", k_write_stm, verify_stm),
};

#define BLOCK_RD(_b)                                                                               \
	{.group = "block", .name = "block_read_" #_b, .fn = k_block_read, .len = BLOCK_TOTAL,      \
	 .bus_mult = 1U, .param = (_b)}
#define BLOCK_WR(_b)                                                                               \
	{.group = "block", .name = "block_write_" #_b, .fn = k_block_write, .len = BLOCK_TOTAL,    \
	 .bus_mult = 1U, .param = (_b), .writes_sdram = true, .verify = verify_block_write}

static const struct bench_kernel block_tests[] = {
	BLOCK_RD(32),   BLOCK_RD(128),  BLOCK_RD(512),   BLOCK_RD(2048),
	BLOCK_RD(8192), BLOCK_RD(32768), BLOCK_RD(131072),
	BLOCK_WR(32),   BLOCK_WR(128),  BLOCK_WR(512),   BLOCK_WR(2048),
	BLOCK_WR(8192), BLOCK_WR(32768), BLOCK_WR(131072),
};

#define ALT(_k)                                                                                    \
	{.group = "alt", .name = "alternate_2^" #_k, .fn = k_alternate, .src = FULL,               \
	 .bytes = ALT_OPS * 4U, .ops = ALT_OPS, .bus_mult = 1U, .param = (1U << (_k))}

static const struct bench_kernel alt_tests[] = {
	ALT(5),  ALT(6),  ALT(7),  ALT(8),  ALT(9),  ALT(10), ALT(11), ALT(12), ALT(13), ALT(14),
	ALT(15), ALT(16), ALT(17), ALT(18), ALT(19), ALT(20), ALT(21), ALT(22), ALT(23), ALT(24),
	ALT(25),
};

#define ALIGN_RD(_name, _fn, _off)                                                                 \
	{.group = "align", .name = _name, .fn = _fn, .src = BENCH_SDRAM_A, .len = BENCH_BUF_SIZE,  \
	 .bus_mult = 1U, .param = (_off)}
#define ALIGN_WR(_name, _fn, _off, _verify)                                                        \
	{.group = "align", .name = _name, .fn = _fn, .dst = BENCH_SDRAM_A, .len = BENCH_BUF_SIZE,  \
	 .bus_mult = 1U, .param = (_off), .writes_sdram = true, .verify = _verify}

static const struct bench_kernel align_tests[] = {
	ALIGN_RD("read32_off0", k_read32_off, 0U),
	ALIGN_RD("read32_off1", k_read32_off, 1U),
	ALIGN_RD("read32_off2", k_read32_off, 2U),
	ALIGN_RD("read32_off3", k_read32_off, 3U),
	ALIGN_RD("read64_off0", k_read64_off, 0U),
	ALIGN_RD("read64_off4", k_read64_off, 4U),
	ALIGN_WR("write32_off0", k_write32_off, 0U, verify_write32_off),
	ALIGN_WR("write32_off1", k_write32_off, 1U, verify_write32_off),
	ALIGN_WR("write32_off2", k_write32_off, 2U, verify_write32_off),
	ALIGN_WR("write32_off3", k_write32_off, 3U, verify_write32_off),
	ALIGN_WR("write64_off0", k_write64_off, 0U, verify_write64_off),
	ALIGN_WR("write64_off4", k_write64_off, 4U, verify_write64_off),
};

/* Each test moves at least 4 MiB per timed iteration */
#define WS_REPEAT(_sz) (((_sz) >= SB_WIN_SIZE) ? 1U : (uint32_t)(SB_WIN_SIZE / (_sz)))
#define WS(_label, _sz)                                                                            \
	{.group = "wset", .name = "read32_" _label, .fn = k_read32, .src = FULL, .len = (_sz),     \
	 .repeat = WS_REPEAT(_sz), .bus_mult = 1U},                                                \
	{.group = "wset", .name = "write32_" _label, .fn = k_write32, .dst = FULL, .len = (_sz),   \
	 .repeat = WS_REPEAT(_sz), .bus_mult = 1U, .writes_sdram = true,                           \
	 .verify = verify_write32},                                                                \
	{.group = "wset", .name = "copy64_" _label, .fn = k_copy64_half, .dst = FULL, .src = FULL, \
	 .len = (_sz), .bytes = (_sz) / 2U, .repeat = WS_REPEAT(_sz), .bus_mult = 2U,              \
	 .writes_sdram = true, .verify = verify_copy_half}

static const struct bench_kernel wset_tests[] = {
	WS("4k", 4096U),           WS("16k", 16384U),         WS("64k", 65536U),
	WS("256k", 262144U),       WS("1m", 1048576U),        WS("4m", 4194304U),
	WS("16m", 16777216U),      WS("32m", 33554432U),
};

uint32_t bench_access_run(void)
{
	uint32_t fails = 0U;

	bench_section("Mixed read/write");
	fails += bench_kernel_suite(mixed_tests, ARRAY_SIZE(mixed_tests), true);

	bench_section("Random access and latency (ns/op = per access or per dependent load)");
	fails += bench_kernel_suite(random_tests, ARRAY_SIZE(random_tests), true);

	bench_section("Stride sweep (one 32-bit read per stride)");
	fails += bench_kernel_suite(stride_tests, ARRAY_SIZE(stride_tests), true);

	bench_section("Access size sweep");
	fails += bench_kernel_suite(size_tests, ARRAY_SIZE(size_tests), true);

	bench_section("Block size sweep (random block-aligned positions in 64 MiB)");
	fails += bench_kernel_suite(block_tests, ARRAY_SIZE(block_tests), true);

	bench_section("Alternating regions: two 32 B-strided streams 2^k bytes apart");
	fails += bench_kernel_suite(alt_tests, ARRAY_SIZE(alt_tests), true);

	bench_section("Alignment (byte offset of 32-bit and 64-bit accesses)");
	fails += bench_kernel_suite(align_tests, ARRAY_SIZE(align_tests), true);

	bench_section("Working-set sweep 4 KiB - 32 MiB (>= 4 MiB moved per iteration)");
	fails += bench_kernel_suite(wset_tests, ARRAY_SIZE(wset_tests), true);

	return fails;
}
```

## src/bench_stream.c
```c
/*
 * SPDX-License-Identifier: Apache-2.0
 *
 * STREAM-style kernels (McCalpin): Copy, Scale, Add and Triad over three
 * 4 MiB arrays in SDRAM windows A, B and C, in float (single precision, the
 * Cortex-M85 FPU) and uint32_t variants. Bytes are counted as STREAM does:
 * 2 arrays for Copy and Scale, 3 for Add and Triad.
 */

#include <zephyr/kernel.h>

#include "sdram_bench.h"

#define N       (BENCH_BUF_SIZE / sizeof(uint32_t))
#define SCALARF 3.0f
#define SCALARU 3U

static float *const af = (float *)SB_WIN_A;
static float *const bf = (float *)SB_WIN_B;
static float *const cf = (float *)SB_WIN_C;
static uint32_t *const au = (uint32_t *)SB_WIN_A;
static uint32_t *const bu = (uint32_t *)SB_WIN_B;
static uint32_t *const cu = (uint32_t *)SB_WIN_C;

static void k_copy_f(const struct bench_kernel *k)
{
	ARG_UNUSED(k);
	for (size_t i = 0; i < N; i++) {
		cf[i] = af[i];
	}
}

static void k_scale_f(const struct bench_kernel *k)
{
	ARG_UNUSED(k);
	for (size_t i = 0; i < N; i++) {
		bf[i] = SCALARF * cf[i];
	}
}

static void k_add_f(const struct bench_kernel *k)
{
	ARG_UNUSED(k);
	for (size_t i = 0; i < N; i++) {
		cf[i] = af[i] + bf[i];
	}
}

static void k_triad_f(const struct bench_kernel *k)
{
	ARG_UNUSED(k);
	for (size_t i = 0; i < N; i++) {
		af[i] = bf[i] + (SCALARF * cf[i]);
	}
}

static void k_copy_u(const struct bench_kernel *k)
{
	ARG_UNUSED(k);
	for (size_t i = 0; i < N; i++) {
		cu[i] = au[i];
	}
}

static void k_scale_u(const struct bench_kernel *k)
{
	ARG_UNUSED(k);
	for (size_t i = 0; i < N; i++) {
		bu[i] = SCALARU * cu[i];
	}
}

static void k_add_u(const struct bench_kernel *k)
{
	ARG_UNUSED(k);
	for (size_t i = 0; i < N; i++) {
		cu[i] = au[i] + bu[i];
	}
}

static void k_triad_u(const struct bench_kernel *k)
{
	ARG_UNUSED(k);
	for (size_t i = 0; i < N; i++) {
		au[i] = bu[i] + (SCALARU * cu[i]);
	}
}

/* Each kernel is idempotent for unchanged inputs, so its output can be checked */
static bool verify_f(const struct bench_kernel *k, uint32_t calls)
{
	ARG_UNUSED(calls);

	for (size_t i = 0; i < N; i++) {
		bool ok;

		switch (k->param) {
		case 0:
			ok = cf[i] == af[i];
			break;
		case 1:
			ok = bf[i] == (SCALARF * cf[i]);
			break;
		case 2:
			ok = cf[i] == (af[i] + bf[i]);
			break;
		default:
			ok = af[i] == (bf[i] + (SCALARF * cf[i]));
			break;
		}
		if (!ok) {
			printk("    verify %s failed at element %u\n", k->name, (uint32_t)i);
			return false;
		}
	}

	return true;
}

static bool verify_u(const struct bench_kernel *k, uint32_t calls)
{
	ARG_UNUSED(calls);

	for (size_t i = 0; i < N; i++) {
		bool ok;

		switch (k->param) {
		case 0:
			ok = cu[i] == au[i];
			break;
		case 1:
			ok = bu[i] == (SCALARU * cu[i]);
			break;
		case 2:
			ok = cu[i] == (au[i] + bu[i]);
			break;
		default:
			ok = au[i] == (bu[i] + (SCALARU * cu[i]));
			break;
		}
		if (!ok) {
			printk("    verify %s failed at element %u\n", k->name, (uint32_t)i);
			return false;
		}
	}

	return true;
}

static void init_f(const struct bench_kernel *k)
{
	ARG_UNUSED(k);
	for (size_t i = 0; i < N; i++) {
		af[i] = 1.0f;
		bf[i] = 2.0f;
		cf[i] = 0.0f;
	}
	bench_cache_sync();
}

static void init_u(const struct bench_kernel *k)
{
	ARG_UNUSED(k);
	for (size_t i = 0; i < N; i++) {
		au[i] = (uint32_t)i;
		bu[i] = 2U * (uint32_t)i;
		cu[i] = 0U;
	}
	bench_cache_sync();
}

#define STREAM(_name, _fn, _arrays, _id, _verify, _setup)                                          \
	{.group = "stream", .name = _name, .fn = _fn, .len = BENCH_BUF_SIZE,                       \
	 .bytes = (_arrays) * BENCH_BUF_SIZE, .bus_mult = 1U, .param = (_id),                      \
	 .writes_sdram = true,                                                                     \
	 .setup = _setup, .verify = _verify}

static const struct bench_kernel stream_tests[] = {
	STREAM("copy_f32", k_copy_f, 2U, 0U, verify_f, init_f),
	STREAM("scale_f32", k_scale_f, 2U, 1U, verify_f, NULL),
	STREAM("add_f32", k_add_f, 3U, 2U, verify_f, NULL),
	STREAM("triad_f32", k_triad_f, 3U, 3U, verify_f, NULL),
	STREAM("copy_u32", k_copy_u, 2U, 0U, verify_u, init_u),
	STREAM("scale_u32", k_scale_u, 2U, 1U, verify_u, NULL),
	STREAM("add_u32", k_add_u, 3U, 2U, verify_u, NULL),
	STREAM("triad_u32", k_triad_u, 3U, 3U, verify_u, NULL),
};

uint32_t bench_stream_run(void)
{
	bench_section("STREAM Copy/Scale/Add/Triad, 3 x 4 MiB arrays (bytes as STREAM counts)");

	return bench_kernel_suite(stream_tests, ARRAY_SIZE(stream_tests), true);
}
```
